## CMakeLists.txt
```
# Copyright 2025 NXP
#
# SPDX-License-Identifier: Apache-2.0

cmake_minimum_required(VERSION 3.22.0)

include(${SdkRootDirPath}/cmake/extension/mcux.cmake)

project(dm-ip-frdmmcxn947-eth-panel LANGUAGES C CXX ASM)

include(${SdkRootDirPath}/CMakeLists.txt)

# Common ------------------
mcux_add_include(
    INCLUDES src
             board
             comunication
             measures
             measures/mikroe_accel4click
             measures/brd_temp_sensor
             linker
)

mcux_add_source(
    SOURCES src/FreeRTOSConfig_frag.h
            src/lwipopts.h
            src/main.c
            board/board.h
            board/board.c
            board/clock_config.h
            board/clock_config.c
            board/pin_mux.h
            board/pin_mux.c
            board/RTE_Device.h
            board/frdmmcxn947.c
            comunication/can_comunication.h
            comunication/can_comunication.c
            comunication/usb_comunication.h
            comunication/usb_comunication.c
            comunication/eth_comunication.h
            comunication/eth_comunication.c
            comunication/comunication.h
            comunication/comunication.c
            comunication/host_cdc.h
            comunication/host_cdc.c
            comunication/usb_host_config.h
            measures/measures.h
            measures/measures.c
            measures/mikroe_accel4click/mikroe_accel_4_click.h
            measures/mikroe_accel4click/mikroe_accel_4_click.c
            measures/brd_temp_sensor/brd_temp_sensor.h
            measures/brd_temp_sensor/brd_temp_sensor.c
)
# -------------------------

# Motor Control -----------
mcux_add_include(
    INCLUDES motor_control
)
mcux_add_source(
    SOURCES motor_control/mc_periph_init.h
            motor_control/mc_periph_init.c
            motor_control/motor_control.h
            motor_control/motor_control.c
            motor_control/m1_pmsm_appconfig.h
)
mcux_add_macro(
    CC "-DMC_EXAMPLE"
)
# -------------------------

# USB ---------------------
# -------------------------

# USB ---------------------
# -------------------------

# SDIO --------------------
# -------------------------

# ADC ---------------------
# -------------------------

# LWIP --------------------
mcux_add_macro(
    CC "-DUSE_RTOS=1\
        -DPRINTF_ADVANCED_ENABLE=1"
)
# -------------------------

# LVGL --------------------
mcux_add_include(
    INCLUDES gui_guider/custom
             gui_guider/generated
             gui_guider/generated/guider_customer_fonts
             gui_guider/generated/guider_fonts
             gui_guider/generated/images
             screen
)

mcux_add_source(
    SOURCES gui_guider/custom/lv_conf_ext.h
            gui_guider/custom/custom.h
            gui_guider/custom/custom.c
            gui_guider/generated/events_init.h
            gui_guider/generated/events_init.c
            gui_guider/generated/gui_guider.h
            gui_guider/generated/gui_guider.c
            gui_guider/generated/widgets_init.h
            gui_guider/generated/widgets_init.c
            gui_guider/generated/setup_scr_accelerometer_measure_screen.c
            gui_guider/generated/setup_scr_connection_config_screen.c
            gui_guider/generated/setup_scr_control_panel_screen.c
            gui_guider/generated/setup_scr_cpu_performance_screen.c
            gui_guider/generated/setup_scr_init_screen.c
            gui_guider/generated/setup_scr_menu_screen.c
            gui_guider/generated/setup_scr_server_ip_screen.c
            gui_guider/generated/setup_scr_set_time_screen.c
            gui_guider/generated/setup_scr_stand_by_screen.c
            gui_guider/generated/setup_scr_temperature_measure_screen.c
            gui_guider/generated/setup_scr_touch_measure_screen.c
            gui_guider/generated/guider_customer_fonts/*.h
            gui_guider/generated/guider_customer_fonts/*.c
            gui_guider/generated/guider_fonts/*.h
            gui_guider/generated/guider_fonts/*.c
            gui_guider/generated/images/*.h
            gui_guider/generated/images/*.c
            screen/lvgl_demo_utils.h
            screen/lvgl_demo_utils.c
            screen/lvgl_freertos.h
            screen/lvgl_freertos.c
            screen/screen_app.h
            screen/screen_app.c
            screen/screen.h
            screen/screen.c
)
# -------------------------

# Linker ------------------
mcux_remove_armgcc_linker_script(
    TARGETS debug release
    BASE_PATH ${SdkRootDirPath}
    LINKER ${device_root}/${soc_portfolio}/${soc_series}/${device}/gcc/MCXN947_cm33_core0_flash.ld
    STARTUP ${device_root}/${soc_portfolio}/${soc_series}/${device}/gcc/startup_MCXN947_cm33_core0.S
)
mcux_add_armgcc_linker_script(
    TARGETS debug release
    LINKER linker/MCXN947_cm33_core0_flash.ld
    STARTUP linker/startup_MCXN947_cm33_core0.S
)
# -------------------------

include(${SdkRootDirPath}/${board_root}/${board}/demo_apps/mc_pmsm/pmsm_enc/${multicore_foldername}/reconfig.cmake OPTIONAL)

mcux_convert_binary(BINARY ${APPLICATION_BINARY_DIR}/${MCUX_SDK_PROJECT_NAME}.bin)
```

## prj.conf
```kconfig
# Copyright 2025 NXP
#
# SPDX-License-Identifier: Apache-2.0

# General -------------------------------------------------
CONFIG_MCUX_PRJSEG_module.board.pinmux_customize_folder=y
CONFIG_MCUX_PRJSEG_project.hw_app_customize_folder=y
CONFIG_MCUX_PRJSEG_module.board.clock_customize_folder=y
CONFIG_MCUX_PRJSEG_module.board.boardfile=n
#CONFIG_MCUX_PRJSEG_project.hw_app_project_core_folder=y
# ---------------------------------------------------------

# Drivers -------------------------------------------------
# Input MUX ------------------
CONFIG_MCUX_COMPONENT_driver.inputmux=y
# ----------------------------
# ADC ------------------------
CONFIG_MCUX_COMPONENT_driver.lpadc=y
# ----------------------------
# Camparator -----------------
CONFIG_MCUX_COMPONENT_driver.lpcmp=y
# ----------------------------
# Port -----------------------
CONFIG_MCUX_COMPONENT_driver.port=y
# ----------------------------
# ENET -----------------------
CONFIG_MCUX_COMPONENT_driver.mcx_enet=y
CONFIG_MCUX_COMPONENT_driver.romapi_flashiap=y
# ----------------------------
# I2C ------------------------
CONFIG_MCUX_COMPONENT_driver.cmsis_lpi2c=y
CONFIG_MCUX_COMPONENT_driver.dma=y
CONFIG_MCUX_COMPONENT_driver.dmamux=y
CONFIG_MCUX_COMPONENT_driver.edma=y
CONFIG_MCUX_COMPONENT_driver.lpi2c=y
CONFIG_MCUX_COMPONENT_driver.lpi2c_edma=y
# ----------------------------
# I3C ------------------------
CONFIG_MCUX_COMPONENT_driver.i3c=y
CONFIG_MCUX_COMPONENT_driver.p3t1755=y
# ----------------------------
# GPIO -----------------------
CONFIG_MCUX_COMPONENT_component.gpio_adapter=y
# ----------------------------
# CAN ------------------------
CONFIG_MCUX_COMPONENT_driver.flexcan=y
# ----------------------------
# MRT ------------------------
CONFIG_MCUX_COMPONENT_driver.mrt=y
# ----------------------------
# VREF -----------------------
CONFIG_MCUX_COMPONENT_driver.vref_1=y
# ----------------------------
# RTC ------------------------
CONFIG_MCUX_COMPONENT_driver.irtc=y
# ----------------------------
# LPTMR ----------------------
CONFIG_MCUX_COMPONENT_driver.lptmr=y
# ----------------------------
# ---------------------------------------------------------

# FreeRTOS ------------------------------------------------
CONFIG_MCUX_COMPONENT_middleware.freertos-kernel.cm33_non_trustzone=y
CONFIG_MCUX_COMPONENT_middleware.freertos-kernel=y
CONFIG_MCUX_COMPONENT_middleware.freertos-kernel.heap_4=y
CONFIG_FREERTOS_USE_CUSTOM_CONFIG_FRAGMENT=y
CONFIG_configTOTAL_HEAP_SIZE=92160
CONFIG_configTICK_RATE_HZ=1000
CONFIG_configMAX_PRIORITIES=18
CONFIG_configUSE_TICK_HOOK=y
CONFIG_configUSE_APPLICATION_TASK_TAG=y
CONFIG_configCHECK_FOR_STACK_OVERFLOW=y
CONFIG_configUSE_MALLOC_FAILED_HOOK=y
# ---------------------------------------------------------

# Motor Control -------------------------------------------
CONFIG_MCUX_COMPONENT_middleware.mc_pmsm_enc.float=y
CONFIG_MCUX_COMPONENT_middleware.motor_control_pmsm_float.tsa=y
CONFIG_MCUX_COMPONENT_middleware.motor_control.mc_drivers_adcncxn_pwma_qdc=y
CONFIG_MCUX_COMPONENT_middleware.fmstr=y
CONFIG_MCUX_COMPONENT_middleware.fmstr.platform_gen32le=y
CONFIG_MCUX_PRJSEG_middleware.fmstr.generated_config=n
CONFIG_MCUX_COMPONENT_middleware.motor_control_pmsm_float_imcat=y
CONFIG_MCUX_COMPONENT_middleware.pmsm_mid.float=y
CONFIG_MCUX_COMPONENT_utility.assert_lite=y
CONFIG_MCUX_COMPONENT_utility.debug_console_lite=y
# ---------------------------------------------------------

# CMSIS ---------------------------------------------------
CONFIG_MCUX_COMPONENT_CMSIS_DSP_Include=y
CONFIG_MCUX_COMPONENT_CMSIS_DSP_Source=y
# ---------------------------------------------------------

# USB -----------------------------------------------------
CONFIG_DEBUG_CONSOLE_RECEIVE_BUFFER_LEN=16U
CONFIG_DEBUG_CONSOLE_RX_ENABLE=n
CONFIG_DEBUG_CONSOLE_TRANSMIT_BUFFER_LEN=64U
CONFIG_FSL_OSA_TASK_ENABLE=n
CONFIG_MCUX_COMPONENT_middleware.usb.common_header=y
CONFIG_MCUX_COMPONENT_middleware.usb.host.common_header=y
CONFIG_MCUX_PRJSEG_component.osa_interface.generated_config=y
CONFIG_MCUX_PRJSEG_component.osa_interface.osa_macro_used=n
CONFIG_MCUX_PRJSEG_middleware.freertos-kernel.generated_config=y
CONFIG_MCUX_PRJSEG_module.board.console=y
CONFIG_MCUX_PRJSEG_module.board.console_lite=n
CONFIG_MCUX_PRJSEG_utility.debug_console_transfer_non_blocking=y
CONFIG_USB_HOST_CONFIG_CDC=1
CONFIG_configENABLE_MPU=n
CONFIG_configTIMER_QUEUE_LENGTH=10
CONFIG_configUSE_TIME_SLICING=y
# ---------------------------------------------------------

# LWIP ----------------------------------------------------
CONFIG_MCUX_COMPONENT_driver.mcx_enet=y
CONFIG_MCUX_COMPONENT_driver.romapi_flashiap=y
CONFIG_MCUX_COMPONENT_component.phylan8741=y
CONFIG_MCUX_COMPONENT_component.silicon_id=y
CONFIG_MCUX_COMPONENT_middleware.lwip.mcx_ethernetif=y

CONFIG_MCUX_COMPONENT_component.silicon_id=y

# lwIP configuration:
CONFIG_MCUX_COMPONENT_middleware.lwip=y
CONFIG_MCUX_PRJSEG_middleware.lwip.generated_config=y
CONFIG_LWIP_OPT_H_CODE_LINE_1="void sys_lock_tcpip_core(void);"
CONFIG_LWIP_OPT_H_CODE_LINE_2="void sys_unlock_tcpip_core(void);"
CONFIG_LWIP_OPT_H_CODE_LINE_3="void sys_check_core_locking(void);"
CONFIG_LWIP_OPT_H_CODE_LINE_4="void sys_mark_tcpip_thread(void);"
CONFIG_SYS_LIGHTWEIGHT_PROT=y
CONFIG_NO_SYS=n
CONFIG_LWIP_NETCONN=y
CONFIG_LWIP_SOCKET=y
CONFIG_LWIP_SO_RCVTIMEO=y
CONFIG_LWIP_TCPIP_CORE_LOCKING=y
CONFIG_LOCK_TCPIP_CORE_CUSTOM( )="sys_lock_tcpip_core()"
CONFIG_UNLOCK_TCPIP_CORE_CUSTOM( )="sys_unlock_tcpip_core()"
CONFIG_LWIP_ASSERT_CORE_LOCKED( )="sys_check_core_locking()"
CONFIG_LWIP_MARK_TCPIP_THREAD( )="sys_mark_tcpip_thread()"
CONFIG_MEM_ALIGNMENT=4
CONFIG_MEM_SIZE=22528
CONFIG_MEMP_NUM_PBUF=15
CONFIG_MEMP_NUM_UDP_PCB=6
CONFIG_MEMP_NUM_TCP_PCB=10
CONFIG_MEMP_NUM_TCP_PCB_LISTEN=6
CONFIG_MEMP_NUM_TCP_SEG=22
CONFIG_MEMP_NUM_SYS_TIMEOUT="10"
CONFIG_MEMP_NUM_REASSDATA=2
CONFIG_PBUF_POOL_SIZE=5
CONFIG_LWIP_TCP=y
CONFIG_TCP_TTL=255
CONFIG_TCP_QUEUE_OOSEQ=n
CONFIG_TCP_MSS=1460
CONFIG_TCP_SND_BUF="(6 * TCP_MSS)"
CONFIG_TCP_SND_QUEUELEN="((3 * TCP_SND_BUF) / TCP_MSS)"
CONFIG_TCP_WND="(2 * TCP_MSS)"
CONFIG_TCP_LISTEN_BACKLOG=y
CONFIG_LWIP_NETIF_API=y
CONFIG_LWIP_ICMP=y
CONFIG_LWIP_DHCP=y
CONFIG_LWIP_UDP=y
CONFIG_UDP_TTL=255
CONFIG_LWIP_STATS=n
CONFIG_LWIP_PROVIDE_ERRNO=y
CONFIG_DEFAULT_THREAD_STACKSIZE=3000
CONFIG_DEFAULT_THREAD_PRIO=3
CONFIG_LWIP_DEBUG=y
CONFIG_TCPIP_MBOX_SIZE=32
CONFIG_TCPIP_THREAD_STACKSIZE=1024
CONFIG_TCPIP_THREAD_PRIO=8
CONFIG_DEFAULT_RAW_RECVMBOX_SIZE=12
CONFIG_DEFAULT_UDP_RECVMBOX_SIZE=12
CONFIG_DEFAULT_TCP_RECVMBOX_SIZE=12
CONFIG_DEFAULT_ACCEPTMBOX_SIZE=12
CONFIG_LWIP_NETIF_EXT_STATUS_CALLBACK=y
CONFIG_IP_REASS_MAX_PBUFS=4
CONFIG_LWIP_SINGLE_NETIF=y
# ---------------------------------------------------------

# LVGL ----------------------------------------------------
CONFIG_MCUX_PRJSEG_module.board.lvgl=y
CONFIG_LV_MEM_SIZE_KILOBYTES=64
# LVGL config -----------------------------------
CONFIG_LV_SYSMON_GET_IDLE="getIdleTaskPct"
CONFIG_LV_OS_FREERTOS=y
CONFIG_LV_USE_SYSMON=y
CONFIG_LV_USE_ASSERT_NULL=n
CONFIG_LV_USE_ASSERT_MALLOC=n
CONFIG_LV_CONF_MINIMAL=y
CONFIG_LV_USE_THEME_DEFAULT=y
# -----------------------------------------------
# LVGL Fonts ------------------------------------
CONFIG_LV_TXT_ENC_UTF8=y
CONFIG_LV_FONT_MONTSERRAT_11=y
CONFIG_LV_FONT_MONTSERRAT_12=y
CONFIG_LV_FONT_MONTSERRAT_16=y
CONFIG_LV_FONT_MONTSERRAT_20=y
# -----------------------------------------------
# Widgets ---------------------------------------
CONFIG_LV_USE_LABEL=y
CONFIG_LV_USE_CHART=y
CONFIG_LV_USE_IMAGE=y
CONFIG_LV_USE_CHECKBOX=y
CONFIG_LV_USE_BUTTON=y
CONFIG_LV_USE_BAR=y
CONFIG_LV_USE_ARC=y
CONFIG_LV_USE_ROLLER=y
CONFIG_LV_USE_SLIDER=y
CONFIG_LV_USE_LINE=y
CONFIG_LV_USE_SCALE=y
# -----------------------------------------------
# ---------------------------------------------------------
```

## src/main.c
```c
/*
 * Copyright 2025-2026 NXP
 *
 * SPDX-License-Identifier: BSD-3-Clause
 */

#include "eth_comunication.h"
#include "fsl_clock.h"
#include "pin_mux.h"
#include "board.h"
#include "FreeRTOS.h"
#include "task.h"
#include "fsl_debug_console.h"
#include "screen.h"
#include "measures.h"
#include "screen_app.h"
#include "motor_control.h"
#include "usb_comunication.h"
#include "can_comunication.h"

/*******************************************************************************
 * Variables
 ******************************************************************************/
void idle_task(void* args);

int main()
{
	BOARD_InitBootPins();
	BOARD_InitBootClocks();
    BOARD_I2C_ReleaseBus();
	BOARD_InitDebugConsole();

	CLOCK_SetupClockCtrl(kCLOCK_FRO12MHZ_ENA);
	
    CLOCK_SetClkDiv(kCLOCK_DivFlexcom2Clk, 1u);
    CLOCK_AttachClk(kFRO12M_to_FLEXCOMM2);

    CLOCK_SetClkDiv(kCLOCK_DivFlexioClk, 1u);
    CLOCK_AttachClk(kPLL0_to_FLEXIO);

    CLOCK_SetupExtClocking(BOARD_XTAL0_CLK_HZ);

    measures_init();
    comunication_init();
    BOARD_InitSmartDMA();
    screen_setCallback(screenEventCallback);
    motor_control_init();
	motor_control_stop();

	xTaskCreate(screenTask, "screen", configMINIMAL_STACK_SIZE + 1500, NULL, tskIDLE_PRIORITY + 2, NULL);
	xTaskCreate(usb_task, "usb_task", configMINIMAL_STACK_SIZE + 1000, NULL, tskIDLE_PRIORITY + 1, NULL);
	xTaskCreate(can_comunication_task, "can_task", configMINIMAL_STACK_SIZE + 500, NULL, tskIDLE_PRIORITY + 1, NULL);
	xTaskCreate(measures_task, "measures", configMINIMAL_STACK_SIZE + 500, NULL, tskIDLE_PRIORITY + 1, NULL);
	xTaskCreate(motor_control_task, "motor_control", configMINIMAL_STACK_SIZE + 500, NULL, tskIDLE_PRIORITY + 3, NULL);
	xTaskCreate(idle_task, "idle", configMINIMAL_STACK_SIZE, NULL, tskIDLE_PRIORITY, NULL);
	vTaskStartScheduler();
	while(1)
	{

	}
	return 0;
}



void vApplicationTickHook(void)
{
	screenTick();
}

void vApplicationStackOverflowHook(TaskHandle_t xTask, char *pcTaskName)
{
   PRINTF("Stack Overflow\r\n");
    while(1);
}

void vApplicationMallocFailedHook(void)
{
	PRINTF("Malloc Fail\r\n");
    while(1);
}

void idle_task(void* args)
{
	vTaskSetApplicationTaskTag( NULL, ( void * ) 0);/*Task Tag*/

	while(1)
	{
		vTaskDelay(10);
	}
}
```

## src/FreeRTOSConfig_frag.h
```c
/*
 * Copyright 2026 NXP
 *
 * SPDX-License-Identifier: BSD-3-Clause
 */

#ifndef FREERTOS_CONFIG_FRAG_H
#define FREERTOS_CONFIG_FRAG_H

#include "measures.h"


volatile static int value = 0;

#define traceTASK_SWITCHED_IN()					\
{												\
	switch((int)pxCurrentTCB->pxTaskTag)		\
	{											\
		case 0:									\
			measures_idle_core1_task_in();		\
		break;									\
												\
		case 1:									\
			measures_lvgl_task_in();			\
		break;									\
												\
		case 2:						     		\
			measures_sensor_task_in();			\
		break;									\
												\
		case 3:						     		\
			measures_ethernet_task_in();		\
		break;									\
												\
		case 4:						     		\
			measures_motor_control_task_in();	\
		break;									\
	}											\
}


#define traceTASK_SWITCHED_OUT()				\
{												\
	switch((int)pxCurrentTCB->pxTaskTag)		\
	{											\
		case 0:									\
			measures_idle_core1_task_out();		\
		break;									\
												\
		case 1:									\
			measures_lvgl_task_out();			\
		break;									\
												\
		case 2:						     		\
			measures_sensor_task_out();			\
		break;									\
												\
		case 3:						     		\
			measures_ethernet_task_out();		\
		break;									\
												\
		case 4:						     		\
			measures_motor_control_task_out();	\
		break;									\
	}											\
}

#endif /* FREERTOS_CONFIG_FRAG_H */
```

## src/lwipopts.h
```c
/**
 ******************************************************************************
 * @file    lwipopts.h
 * This file is based on \src\include\lwip\opt.h
 ******************************************************************************
 * Copyright (c) 2013-2016, Freescale Semiconductor, Inc.
 * Copyright 2016-2018, 2022-2023, 2026 NXP
 *
 * SPDX-License-Identifier: BSD-3-Clause
 */

#ifndef __LWIPOPTS_H__
#define __LWIPOPTS_H__

#if USE_RTOS

/**
 * SYS_LIGHTWEIGHT_PROT==1: if you want inter-task protection for certain
 * critical regions during buffer allocation, deallocation and memory
 * allocation and deallocation.
 */
#define SYS_LIGHTWEIGHT_PROT 1

/**
 * NO_SYS==0: Use RTOS
 */
#define NO_SYS 0
/**
 * LWIP_NETCONN==1: Enable Netconn API (require to use api_lib.c)
 */
#define LWIP_NETCONN 1
/**
 * LWIP_SOCKET==1: Enable Socket API (require to use sockets.c)
 */
#define LWIP_SOCKET 1

/**
 * LWIP_SO_RCVTIMEO==1: Enable receive timeout for sockets/netconns and
 * SO_RCVTIMEO processing.
 */
#define LWIP_SO_RCVTIMEO 1

#else
/**
 * NO_SYS==1: Bare metal lwIP
 */
#define NO_SYS       1
/**
 * LWIP_NETCONN==0: Disable Netconn API (require to use api_lib.c)
 */
#define LWIP_NETCONN 0
/**
 * LWIP_SOCKET==0: Disable Socket API (require to use sockets.c)
 */
#define LWIP_SOCKET  0

#endif

/* ---------- Core locking ---------- */

#define LWIP_TCPIP_CORE_LOCKING 1

void sys_lock_tcpip_core(void);
#define LOCK_TCPIP_CORE() sys_lock_tcpip_core()

void sys_unlock_tcpip_core(void);
#define UNLOCK_TCPIP_CORE() sys_unlock_tcpip_core()

void sys_check_core_locking(void);
#define LWIP_ASSERT_CORE_LOCKED() sys_check_core_locking()

void sys_mark_tcpip_thread(void);
#define LWIP_MARK_TCPIP_THREAD() sys_mark_tcpip_thread()

/* ---------- Memory options ---------- */
/**
 * MEM_ALIGNMENT: should be set to the alignment of the CPU
 *    4 byte alignment -> #define MEM_ALIGNMENT 4
 *    2 byte alignment -> #define MEM_ALIGNMENT 2
 */
#ifndef MEM_ALIGNMENT
#define MEM_ALIGNMENT 4
#endif

/**
 * MEM_SIZE: the size of the heap memory. If the application will send
 * a lot of data that needs to be copied, this should be set high.
 */
#ifndef MEM_SIZE
#define MEM_SIZE (22 * 1024)
#endif

/* MEMP_NUM_PBUF: the number of memp struct pbufs. If the application
   sends a lot of data out of ROM (or other static memory), this
   should be set high. */
#ifndef MEMP_NUM_PBUF
#define MEMP_NUM_PBUF 15
#endif
/* MEMP_NUM_UDP_PCB: the number of UDP protocol control blocks. One
   per active UDP "connection". */
#ifndef MEMP_NUM_UDP_PCB
#define MEMP_NUM_UDP_PCB 6
#endif
/* MEMP_NUM_TCP_PCB: the number of simulatenously active TCP
   connections. */
#ifndef MEMP_NUM_TCP_PCB
#define MEMP_NUM_TCP_PCB 10
#endif
/* MEMP_NUM_TCP_PCB_LISTEN: the number of listening TCP
   connections. */
#ifndef MEMP_NUM_TCP_PCB_LISTEN
#define MEMP_NUM_TCP_PCB_LISTEN 6
#endif
/* MEMP_NUM_TCP_SEG: the number of simultaneously queued TCP
   segments. */
#ifndef MEMP_NUM_TCP_SEG
#define MEMP_NUM_TCP_SEG 22
#endif
/* MEMP_NUM_SYS_TIMEOUT: the number of simulateously active
   timeouts. */
#ifndef MEMP_NUM_SYS_TIMEOUT
#define MEMP_NUM_SYS_TIMEOUT 10
#endif
/* MEMP_NUM_REASS_DATA: The number of whole IP packets
   queued for reassembly. */
#ifndef MEMP_NUM_REASSDATA
#define MEMP_NUM_REASSDATA 2
#endif

/* ---------- Pbuf options ---------- */
/* PBUF_POOL_SIZE: the number of buffers in the pbuf pool. */
#ifndef PBUF_POOL_SIZE
#define PBUF_POOL_SIZE 5
#endif

/* PBUF_POOL_BUFSIZE: the size of each pbuf in the pbuf pool. */
/* Default value is defined in lwip\src\include\lwip\opt.h as
 * LWIP_MEM_ALIGN_SIZE(TCP_MSS+40+PBUF_LINK_ENCAPSULATION_HLEN+PBUF_LINK_HLEN)*/

/* ---------- TCP options ---------- */
#ifndef LWIP_TCP
#define LWIP_TCP 1
#endif

#ifndef TCP_TTL
#define TCP_TTL 255
#endif

/* Controls if TCP should queue segments that arrive out of
   order. Define to 0 if your device is low on memory. */
#ifndef TCP_QUEUE_OOSEQ
#define TCP_QUEUE_OOSEQ 0
#endif

/* TCP Maximum segment size. */
#ifndef TCP_MSS
#define TCP_MSS (1500 - 40) /* TCP_MSS = (Ethernet MTU - IP header size - TCP header size) */
#endif

/* TCP sender buffer space (bytes). */
#ifndef TCP_SND_BUF
#define TCP_SND_BUF (6 * TCP_MSS) // 2
#endif

/* TCP sender buffer space (pbufs). This must be at least = 2 *
   TCP_SND_BUF/TCP_MSS for things to work. */
#ifndef TCP_SND_QUEUELEN
#define TCP_SND_QUEUELEN (3 * TCP_SND_BUF) / TCP_MSS // 6
#endif

/* TCP receive window. */
#ifndef TCP_WND
#define TCP_WND (2 * TCP_MSS)
#endif

/* Enable backlog*/
#ifndef TCP_LISTEN_BACKLOG
#define TCP_LISTEN_BACKLOG 1
#endif

/* ---------- Network Interfaces options ---------- */
/* Support netif api (in netifapi.c). */
#ifndef LWIP_NETIF_API
#define LWIP_NETIF_API 1
#endif

/* ---------- ICMP options ---------- */
#ifndef LWIP_ICMP
#define LWIP_ICMP 1
#endif

/* ---------- RAW options ---------- */
#if !defined LWIP_RAW
#define LWIP_RAW 1
#endif

/* ---------- DHCP options ---------- */
/* Enable DHCP module. */
#ifndef LWIP_DHCP
#define LWIP_DHCP 1
#endif

/* ---------- UDP options ---------- */
#ifndef LWIP_UDP
#define LWIP_UDP 1
#endif
#ifndef UDP_TTL
#define UDP_TTL 255
#endif

/* ---------- Statistics options ---------- */
#ifndef LWIP_STATS
#define LWIP_STATS 0
#endif
#ifndef LWIP_PROVIDE_ERRNO
#define LWIP_PROVIDE_ERRNO 1
#endif

/*
   --------------------------------------
   ---------- Checksum options ----------
   --------------------------------------
*/

/**
 * Checksum computation verification and computation enabled by default.
 * If not desired, define all of these symbols as 1.
 */
#ifndef CHECKSUM_GEN_IP
#define CHECKSUM_GEN_IP 1
#endif

#ifndef CHECKSUM_GEN_UDP
#define CHECKSUM_GEN_UDP 1
#endif

#ifndef CHECKSUM_GEN_TCP
#define CHECKSUM_GEN_TCP 1
#endif

#ifndef CHECKSUM_GEN_ICMP
#define CHECKSUM_GEN_ICMP 1
#endif

#ifndef CHECKSUM_GEN_ICMP6
#define CHECKSUM_GEN_ICMP6 1
#endif

#ifndef CHECKSUM_CHECK_IP
#define CHECKSUM_CHECK_IP 1
#endif

#ifndef CHECKSUM_CHECK_UDP
#define CHECKSUM_CHECK_UDP 1
#endif

#ifndef CHECKSUM_CHECK_TCP
#define CHECKSUM_CHECK_TCP 1
#endif

#ifndef CHECKSUM_CHECK_ICMP
#define CHECKSUM_CHECK_ICMP 1
#endif

#ifndef CHECKSUM_CHECK_ICMP6
#define CHECKSUM_CHECK_ICMP6 1
#endif

/**
 * DEFAULT_THREAD_STACKSIZE: The stack size used by any other lwIP thread.
 * The stack size value itself is platform-dependent, but is passed to
 * sys_thread_new() when the thread is created.
 */
#ifndef DEFAULT_THREAD_STACKSIZE
#define DEFAULT_THREAD_STACKSIZE 3000
#endif

/**
 * DEFAULT_THREAD_PRIO: The priority assigned to any other lwIP thread.
 * The priority value itself is platform-dependent, but is passed to
 * sys_thread_new() when the thread is created.
 */
#ifndef DEFAULT_THREAD_PRIO
#define DEFAULT_THREAD_PRIO 3
#endif

/*
   ------------------------------------
   ---------- Debugging options ----------
   ------------------------------------
*/

#define LWIP_DEBUG

#ifdef LWIP_DEBUG
#define U8_F  "c"
#define S8_F  "c"
#define X8_F  "02x"
#define U16_F "u"
#define S16_F "d"
#define X16_F "x"
#define U32_F "u"
#define S32_F "d"
#define X32_F "x"
#define SZT_F "u"
#endif

#define TCPIP_MBOX_SIZE        32
#define TCPIP_THREAD_STACKSIZE 1024
#define TCPIP_THREAD_PRIO      8

/**
 * DEFAULT_RAW_RECVMBOX_SIZE: The mailbox size for the incoming packets on a
 * NETCONN_RAW. The queue size value itself is platform-dependent, but is passed
 * to sys_mbox_new() when the recvmbox is created.
 */
#define DEFAULT_RAW_RECVMBOX_SIZE 12

/**
 * DEFAULT_UDP_RECVMBOX_SIZE: The mailbox size for the incoming packets on a
 * NETCONN_UDP. The queue size value itself is platform-dependent, but is passed
 * to sys_mbox_new() when the recvmbox is created.
 */
#define DEFAULT_UDP_RECVMBOX_SIZE 12

/**
 * DEFAULT_TCP_RECVMBOX_SIZE: The mailbox size for the incoming packets on a
 * NETCONN_TCP. The queue size value itself is platform-dependent, but is passed
 * to sys_mbox_new() when the recvmbox is created.
 */
#define DEFAULT_TCP_RECVMBOX_SIZE 12

/**
 * DEFAULT_ACCEPTMBOX_SIZE: The mailbox size for the incoming connections.
 * The queue size value itself is platform-dependent, but is passed to
 * sys_mbox_new() when the acceptmbox is created.
 */
#define DEFAULT_ACCEPTMBOX_SIZE 12

#if (LWIP_DNS || LWIP_IGMP || LWIP_IPV6) && !defined(LWIP_RAND)
/* When using IGMP or IPv6, LWIP_RAND() needs to be defined to a random-function returning an u32_t random value*/
#include "lwip/arch.h"
u32_t lwip_rand(void);
#define LWIP_RAND() lwip_rand()
#endif

/**
 * LWIP_NETIF_EXT_STATUS_CALLBACK==1: Support an extended callback function
 * for several netif related event that supports multiple subscribers.
 * @see netif_ext_status_callback
 */
#define LWIP_NETIF_EXT_STATUS_CALLBACK 1

/**
 * IP_REASS_MAX_PBUFS: Number of buffers reserved for IP fragment reassembly.
 */
#ifndef IP_REASS_MAX_PBUFS
#define IP_REASS_MAX_PBUFS 4
#endif

/*
   ------------------------------------------------
   ---------- Network Interfaces options ----------
   ------------------------------------------------
*/
/**
 * @defgroup lwip_opts_netif NETIF
 * @ingroup lwip_opts
 * @{
 */
/**
 * LWIP_SINGLE_NETIF==1: use a single netif only. This is the common case for
 * small real-life targets. Some code like routing etc. can be left out.
 */
#ifndef LWIP_SINGLE_NETIF
#define LWIP_SINGLE_NETIF 1
#endif

#endif /* __LWIPOPTS_H__ */

/*****END OF FILE****/
```
